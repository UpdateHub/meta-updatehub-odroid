## conf/layer.conf
```bitbake
# We have a conf and classes directory, add to BBPATH
BBPATH .= ":${LAYERDIR}"

# We have recipes-* directories, add to BBFILES
BBFILES += "${LAYERDIR}/recipes-*/*/*.bb \
            ${LAYERDIR}/recipes-*/*/*.bbappend"

BBFILE_COLLECTIONS += "updatehub-odroid"
BBFILE_PATTERN_updatehub-odroid = "^${LAYERDIR}/"
BBFILE_PRIORITY_updatehub-odroid = "6"

LAYERDEPENDS_updatehub-odroid = "updatehub odroid-layer"

LAYERSERIES_COMPAT_updatehub-odroid = "sumo"

###
# Global setting to use UpadateHub with meta-odroid layer
#
# Setting to use wic image
IMAGE_BOOT_FILES_updatehub-odroid ??= ""
IMAGE_FSTYPES_updatehub-odroid ??= "tar.xz wic.gz"
WKS_FILE_DEPENDS_updatehub-odroid += "virtual/bootloader"

# UpdateHub settings
UPDATEHUB_ACTIVE_INACTIVE_BACKEND_updatehub-odroid ??= "u-boot"
UPDATEHUB_DEVICE_IDENTITY_updatehub-odroid ??= "primary-iface"
UPDATEHUB_FILESYSTEM_SUPPORT_updatehub-odroid ??= "ext4"
UPDATEHUB_IMAGE_TYPE_updatehub-odroid ??= "active/inactive"
UPDATEHUB_INSTALL_MODE_updatehub-odroid ??= "tarball"

MACHINE_ESSENTIAL_EXTRA_RDEPENDS_updatehub-odroid += " \
    kernel-image \
    kernel-devicetree \
"

# Do not change fstab file
WIC_CREATE_EXTRA_ARGS_updatehub-odroid ??= "--no-fstab-update"

###
# Configuration for odroid-c2 machine
#
# UpdateHub settings for odroid-c2 machine
MACHINEOVERRIDES_prepend_odroid-c2 = "updatehub-odroid:"
INHERIT_append_updatehub-odroid_odroid-c2 =  " wic_odroid_fixup"
PREFERRED_RPROVIDER_u-boot-fw-utils_updatehub-odroid_odroid-c2 ??= "u-boot-fw-utils"
WKS_FILES_updatehub-odroid_odroid-c2 ??= "updatehub.odroid-c2.wks"
```

## wic/updatehub.odroid-c2.wks
```
# U-Boot is writen by wic_odroid_fixup class
part / --source rootfs --ondisk mmcblk --fstype=ext4 --label system_a  --align 8192 --extra-space 200
part / --source rootfs --ondisk mmcblk --fstype=ext4 --label system_b  --align 8192 --extra-space 200
part /data --ondisk mmcblk --fstype=ext4 --label data --size 16M --align 8192 --extra-space 0

bootloader --ptable msdos
```
